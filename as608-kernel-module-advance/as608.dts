/dts-v1/;
/plugin/;

/* Device tree overlay for AS608 fingerprint sensor.
 * Configures UART and device properties for Raspberry Pi BCM2711.
 */

/ {
    compatible = "brcm,bcm2711"; /* Target platform */

    /* Configure UART0 */
    fragment@0 {
        target = <&uart0>;
        __overlay__ {
            pinctrl-0 = <&uart0_pins>;
            pinctrl-names = "default";
            status = "okay";
        };
    };

    /* Define AS608 device */
    fragment@1 {
        target-path = "/";
        __overlay__ {
            as608@0 {
                compatible = "synochip,as608"; /* Device compatible string */
                reg = <0>; /* Register address */
                baud-rate = <57600>; /* Default baud rate */
                status = "okay";
            };
        };
    };
};